// SPDX-License-Identifier: (GPL-2.0-only OR MIT)
/dts-v1/;
/plugin/;

/ {
	compatible = "rockchip,rk3566-md1000";

	fragment@0 {
		target-path = "/video-codec@fdf80100";
		#address-cells = <2>;
		#size-cells = <2>;

		__overlay__ {
			reg = <0x0 0xfdf80100 0x0 0x100>,
			      <0x0 0xfdf80200 0x0 0x500>,
			      <0x0 0xfdf80700 0x0 0x100>;
			reg-names = "link", "function", "cache";
			assigned-clock-rates = <400000000>, <400000000>,
					       <400000000>, <600000000>;
		};
	};
};
